## conf/layer.conf
```bitbake
# We have a conf and classes directory, add to BBPATH
BBPATH .= ":${LAYERDIR}"

# We have a packages directory, add to BBFILES
BBFILES += "${LAYERDIR}/recipes-*/*/*.bb \
            ${LAYERDIR}/recipes-*/*/*.bbappend"

BBFILE_COLLECTIONS += "ronga-udoo"
BBFILE_PATTERN_ronga-udoo := "^${LAYERDIR}/"
BBFILE_PRIORITY_ronga-udoo = "4"
```

## conf/machine/udoo-dual.conf
```bitbake
#@TYPE: Machine
#@NAME: UDOO Dual
#@SOC: i.MX6Q
#@DESCRIPTION: Machine configuration for UDOO Dual

include conf/machine/include/imx-base.inc
include conf/machine/include/tune-cortexa9.inc

SOC_FAMILY = "mx6:mx6q:udoo"

PREFERRED_PROVIDER_virtual/kernel ?= "linux-udoo"

PREFERRED_PROVIDER_u-boot = "u-boot-udoo"

PREFERRED_PROVIDER_virtual/bootloader ?= "u-boot"

UBOOT_MACHINE = "udoo_dl_config"

KERNEL_DEVICETREE = "imx6q-udoo.dtb"

SERIAL_CONSOLE = "115200 ttymxc1"

MACHINE_FEATURES += " pci wifi"
```

## conf/machine/udoo-quad.conf
```bitbake
#@TYPE: Machine
#@NAME: UDOO Quad
#@SOC: i.MX6Q
#@DESCRIPTION: Machine configuration for UDOO Quad

include conf/machine/include/imx-base.inc
include conf/machine/include/tune-cortexa9.inc

SOC_FAMILY = "mx6:mx6q:udoo"

PREFERRED_PROVIDER_virtual/kernel ?= "linux-udoo"

PREFERRED_PROVIDER_u-boot = "u-boot-udoo"

PREFERRED_PROVIDER_virtual/bootloader ?= "u-boot"

UBOOT_MACHINE = "udoo_quad_config"

KERNEL_DEVICETREE = "imx6q-udoo.dtb"

SERIAL_CONSOLE = "115200 ttymxc1"

MACHINE_FEATURES += " pci wifi"
```
